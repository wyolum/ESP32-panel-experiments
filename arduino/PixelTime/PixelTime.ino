#include <Ticker.h>
#include <EEPROM.h>
//#include <WiFi.h>
#include <WiFiClient.h>
#include <ezTime.h>

#include <HTTPClient.h>
#include <ArduinoJson.h>
#define double_buffer
#include <PxMatrix.h>
#include <Fonts/TomThumb.h>
#include "weather_icons.h"

#define logging 0


#include <WiFiManager.h>
WiFiManager wifiManager;
void wifi_setup(){
  Serial.print("Connecting Wifi: ");
  wifiManager.autoConnect("PixelTime");
  Serial.println("Yay connected!");
  Serial.println("IP address: ");
  Serial.println(WiFi.localIP());
}

//MDNSResponder mdns;
Ticker display_ticker;

int brightness=0;
int dimm=0;


// Pins for LED MATRIX
#define P_LAT 22
#define P_A 19
#define P_B 23
#define P_C 18
#define P_D 5
#define P_E 15
#define P_OE 2
hw_timer_t * timer = NULL;
portMUX_TYPE timerMux = portMUX_INITIALIZER_UNLOCKED;
PxMATRIX display(64, 32, P_LAT, P_OE,P_A,P_B,P_C, P_D);
Timezone myTZ;

// Some standard colors
uint16_t myRED = display.color565(255, 0, 0);
uint16_t myGREEN = display.color565(0, 255, 0);
uint16_t myBLUE = display.color565(0, 0, 255);
uint16_t myWHITE = display.color565(255, 255, 255);
uint16_t myYELLOW = display.color565(255, 255, 0);
uint16_t myCYAN = display.color565(0, 255, 255);
uint16_t myMAGENTA = display.color565(255, 0, 255);
uint16_t myBLACK = display.color565(0, 0, 0);

uint16_t myCOLORS[8]={myRED,myGREEN,myBLUE,myWHITE,myYELLOW,myCYAN,myMAGENTA,myBLACK};

// Array that keeps low/high temperatures and icons for two days
int    temperature_show_low[2];
int    temperature_show_high[2];
int    icon_show_low[2];
int    icon_show_high[2];

uint8_t weather_icons_a[]={0x00,0x00,0x00,0x00,0x00,0x00,0x00,0x20,0x00,0x00,0x00,0x00,0x00,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0x00
,0x00,0x00,0x00,0x00,0x00,0x00,0x00,0x00,0xff,0xe0,0x00,0x00,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0x00
,0x00,0x00,0x00,0x00,0xff,0xe0,0x00,0x00,0x00,0x00,0x00,0x00,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0x00
,0x00,0x20,0x00,0x00,0x00,0x00,0xff,0xe0,0xff,0xe0,0xff,0xe0,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0x00
,0x00,0x00,0xff,0xe0,0x00,0x00,0xff,0xe0,0xff,0xe0,0xff,0xe0,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0x00
,0x00,0x00,0x00,0x00,0x00,0x00,0xff,0xe0,0xff,0xe0,0xff,0xe0,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0x00
,0x00,0x00,0x00,0x00,0xff,0xe0,0x00,0x00,0x00,0x00,0x00,0x00,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0x00
,0x00,0x00,0x00,0x00,0x00,0x00,0x00,0x00,0xff,0xe0,0x00,0x00,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0x00
,0x00,0x00,0x00,0x00,0x00,0x00,0x00,0x00,0x00,0x00,0x00,0x00,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0x00
,0x00,0x00,0x00,0x00,0x00,0x00,0x00,0x00,0x00,0x00,0x00,0x00,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0x00
};

uint8_t weather_icons_b[]={0x00,0x00,0x00,0x00,0x00,0x20,0x00,0x00,0xff,0xe0,0x00,0x00,0x00,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0x00
,0x00,0x00,0xff,0xe0,0x00,0x00,0x00,0x00,0x00,0x00,0x00,0x00,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0x00
,0x00,0x20,0x00,0x00,0x00,0x00,0xff,0xe0,0xff,0xe0,0xff,0xe0,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0x00
,0x00,0x00,0x00,0x00,0xff,0xe0,0xff,0xe0,0xff,0xe0,0xff,0xe0,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0x00
,0xff,0xe0,0x00,0x00,0xff,0xe0,0xff,0xe0,0xff,0xe0,0xff,0xe0,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0x00
,0x00,0x00,0x00,0x00,0xff,0xe0,0xff,0xe0,0xff,0xe0,0xff,0xe0,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0x00
,0x00,0x00,0x00,0x00,0x00,0x00,0xff,0xe0,0xff,0xe0,0xff,0xe0,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0x00
,0x00,0x00,0xff,0xe0,0x00,0x00,0x00,0x00,0x00,0x00,0x00,0x00,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0x00
,0x00,0x00,0x00,0x00,0x00,0x00,0x00,0x00,0xff,0xe0,0x00,0x00,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0x20
,0x00,0x00,0x00,0x00,0x00,0x00,0x00,0x00,0x00,0x00,0x00,0x00,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0x00
};

unsigned long next_weather_update=0;
bool weather_get_error;
int sunset;

boolean syncEventTriggered = false; // True if a time even has been triggered

void IRAM_ATTR display_updater(){
  // Increment the counter and set the time of ISR
  portENTER_CRITICAL_ISR(&timerMux);
  display.display(70);
  portEXIT_CRITICAL_ISR(&timerMux);
}

// This gets all the weather data from openweathermap
bool update_weather()
{
  dimm=-1;

  while (brightness>0)
    yield();

  display_ticker.detach();



  String response;

  // Fetch current day - only sunset time information used for now
  HTTPClient http;
  http.begin("http://api.openweathermap.org/data/2.5/weather?q=Berlin,DE&id=WyoTixel&APPID=2823f99338d13ffa45c5c45d80c1c953"); //HTTP
  int httpCode = http.GET();
  if(httpCode > 0) {
    // HTTP header has been send and Server response header has been handled
    Serial.printf("[HTTP] GET... code: %d\n", httpCode);

    if(httpCode == HTTP_CODE_OK) {
      response=http.getString();
      int this_index = response.indexOf("sunset");
      this_index = response.indexOf(":",this_index);
      int next_index = response.indexOf(",",this_index);
      sunset=response.substring(this_index+1,next_index).toInt();

      //Serial.println(response);
      time_t time_now = myTZ.now();
      #ifdef logging
      Serial.println("Got Sunrise at " + String (sunset) + " Now:" + String (time_now));
      #endif
    }
  } else {
    weather_get_error=true;
    Serial.printf("[HTTP] GET... failed, error: %s\n", http.errorToString(httpCode).c_str());

  }
  http.end();

  // Fetch forecast
  HTTPClient http2;

  http2.begin("http://api.openweathermap.org/data/2.5/forecast?q=Berlin,DE&id=WyoTixel&APPID=2823f99338d13ffa45c5c45d80c1c953"); //HTTP
  int httpCode2 = http2.GET();

  // httpCode will be negative on error
  if(httpCode2 > 0) {
    // HTTP header has been send and Server response header has been handled
    Serial.printf("[HTTP] GET... code: %d\n", httpCode2);

    // file found at server
    if(httpCode2 == HTTP_CODE_OK) {
      response=http2.getString();

      weather_get_error=false;
      #ifdef logging
      Serial.println("Weather data received");
      #endif
      http2.end();

    }

  } else {
    weather_get_error=true;
    Serial.printf("[HTTP] GET... failed, error: %s\n", http2.errorToString(httpCode2).c_str());

    // If is this the first fetch and it fails we show zeros
    if (temperature_show_low[0]>90)
    {
      temperature_show_low[0]=0;
      temperature_show_low[1]=0;

      temperature_show_high[0]=0;
      temperature_show_high[1]=0;

      icon_show_low[0]=1;
      icon_show_low[1]=1;

      icon_show_high[0]=1;
      icon_show_high[1]=1;

    }
    http2.end();
    display_ticker.attach(0.001, display_updater);

    dimm=1;
    return false;
  }

  // Ok ... we have some valid response data to work on

  // First day
  int last_index = response.lastIndexOf("dt\"");
  int this_index = response.indexOf("dt\"");
  int next_index =0;
  int day_index=0;

  // Fill high/low with dummy data
  temperature_show_low[0]=+99;
  temperature_show_low[1]=+99;

  temperature_show_high[0]=-99;
  temperature_show_high[1]=-99;

  icon_show_low[0]=-99;
  icon_show_low[1]=-99;

  icon_show_high[0]=+99;
  icon_show_high[1]=+99;

  // Loop over list to find the high/low weather data for today and tomorrow
  int loop_count=-1;
  while (this_index>0)
  {
    loop_count++;

    // Get time of data set
    this_index = response.indexOf(":",this_index);
    String time_stamp = response.substring(this_index+1,this_index+11);
    int time_stamp_int = time_stamp.toInt();
    int time_stamp_hour = myTZ.hour(time_stamp_int);

    // Get temperature of data set
    this_index = response.indexOf("temp\"",this_index);
    this_index = response.indexOf(":",this_index);
    next_index = response.indexOf(",",this_index);

    String temperature = response.substring(this_index+1,next_index);
    int temperature_int = temperature.toInt()-273;

    // Get icon of data set
    this_index = response.indexOf("icon\"",this_index);
    this_index = response.indexOf(":",this_index);
    next_index = response.indexOf("\"",this_index+2);

    String icon = response.substring(this_index+2,next_index-1);
    String night_day = response.substring(next_index-1,next_index);
    int icon_int = icon.toInt();

    // Map fetched icon data to display icon
    switch (icon_int) {
      case 1:
      //do something when var equals 1
      icon_int=0;
      break;
      case 2:
      icon_int=1;
      //do something when var equals 2
      break;
      case 3:
      icon_int=2;
      //do something when var equals 2
      break;
      case 4:
      icon_int=3;
      //do something when var equals 2
      break;
      case 9:
      icon_int=5;
      //do something when var equals 2
      break;
      case 10:
      icon_int=4;
      //do something when var equals 2
      break;
      case 11:
      icon_int=6;
      //do something when var equals 2
      break;
      case 13:
      icon_int=7;
      //do something when var equals 2
      break;
      case 50:
      icon_int=8;
      //do something when var equals 2
      break;
      default:
      icon_int=8;
      break;
    }

    // If there is only one data-set before midnight on the current day we have to display something - just use that midgight data
    if ((time_stamp_hour==0))
    {
      if (loop_count==0)
      {
        temperature_show_low[day_index]=temperature_int;
        temperature_show_high[day_index]=temperature_int;

        icon_show_low[day_index]=icon_int;
        icon_show_high[day_index]=icon_int;
      }
      day_index++;
    }
    if (day_index==2)
    break;


    // Only use data between 6am and 6pm since we most likely will be inside otherwise
    if (((time_stamp_hour>=6)&&(time_stamp_hour<=18))||(temperature_show_low[day_index]>90)||(temperature_show_high[day_index]<-90))
    {
      #ifdef logging
      Serial.println(String(day_index) + " Temp: " + String(temperature_int)+", Icon: " + String(icon_int)+" "+String(night_day));
      #endif

      // Find the max and min over the day
      if (temperature_int<temperature_show_low[day_index])
      temperature_show_low[day_index]=temperature_int;

      if (temperature_int>temperature_show_high[day_index])
      temperature_show_high[day_index]=temperature_int;

      if (icon_int>icon_show_low[day_index])
      icon_show_low[day_index]=icon_int;

      if (icon_int<icon_show_high[day_index])
      icon_show_high[day_index]=icon_int;

    }
    this_index = response.indexOf("dt\"",this_index);

    yield();

  }

  #ifdef logging
  Serial.println("T-Low 0:" + String(temperature_show_low[0])+ ", T-High:" + String(temperature_show_high[0]));
  Serial.println("T-Low 1:" + String(temperature_show_low[1])+ ", T-High:" + String(temperature_show_high[1]));
  Serial.println("I-Low 0:" + String(icon_show_low[0])+ ", I-High:" + String(icon_show_high[0]));
  Serial.println("I-Low 1:" + String(icon_show_low[1])+ ", I-High:" + String(icon_show_high[1]));
  #endif
   dimm=1;
  return true;
}

void clock_setup(){
  String my_tz = "America/New_York"; //get_timezone_from_ip();

  // Setup EZ Time
  setDebug(INFO);
  waitForSync();
  while(!myTZ.setLocation(my_tz)){
    delay(1000);
  }
}

void clock_loop(){
  events();
}

void display_setup(){
  display.begin(16);
  display.flushDisplay();
  display.setTextWrap(false);
  timer = timerBegin(0, 80, true);
  timerAttachInterrupt(timer, &display_updater, true);
  timerAlarmWrite(timer, 2000, true);
  timerAlarmEnable(timer);
  
  display.setTextColor(myCYAN);
  display.setCursor(2,0);
  display.print("Pixel");
  display.setTextColor(myMAGENTA);
  display.setCursor(2,8);
  display.print("Time");
}

void setup() {
  // put your setup code here, to run once:
  Serial.begin(115200);
  wifi_setup();
  display_setup();
  clock_setup();

  EEPROM.begin(512);

  // display_ticker.attach(0.001, display_updater);
  dimm=1;
  yield();
  delay(3000);

}

union single_double{
  uint8_t two[2];
  uint16_t one;
} this_single_double;

// This draws the weather icons and temperature
void draw_weather_icon (uint8_t icon, uint8_t location, int temp,bool ab)
{
  display.setFont(&TomThumb);

  if (location>2)
  location=2;

  if (icon>10)
  icon=10;
  for (int yy=0; yy<10;yy++)
  {
    for (int xx=0; xx<10;xx++)
    {
      uint16_t byte_pos=(xx+icon*10)*2+yy*220;
      if (ab){
        this_single_double.two[1]=weather_icons_a[byte_pos];
        this_single_double.two[0]=weather_icons_a[byte_pos+1];
      }
      else
      {
        this_single_double.two[1]=weather_icons_b[byte_pos];
        this_single_double.two[0]=weather_icons_b[byte_pos+1];
      }
      display.drawPixel(1+xx+location*12,yy,this_single_double.one);
    }

  }

  int pixel_shift=0;
  if ((temp>-10)&&(temp<10))
  pixel_shift=2;

  if (location==0)
  display.setCursor(2+pixel_shift,16);
  else
  display.setCursor(14+pixel_shift,16);

  if (temp<0)
  {
    temp=temp*-1;
    if (location==0)
    display.drawPixel(pixel_shift,13,myWHITE);
    else
    display.drawPixel(12+pixel_shift,13,myWHITE);
  }
  display.println(temp);
}

// This draws the time
void draw_time ()
{
  uint8_t this_hour= myTZ.hour();
  uint8_t this_minute= myTZ.minute();
  uint8_t this_second= myTZ.second();
  display.setFont(&TomThumb);
  display.setTextColor(myWHITE);
  display.setCursor(25,6);
  if (this_hour<10)
    display.println("0"+String(this_hour));
  else
    display.println(this_hour);
  display.setCursor(25,16);

  if (this_minute<10)
    display.println("0"+String(this_minute));
  else
    display.println(this_minute);

  // Dots
  display.drawPixel(27,8,myWHITE);
  display.drawPixel(29,8,myWHITE);

}

void loop() {
  bool ret_code;
  unsigned long this_time=millis();

  // Update weather data every 10 minutes
  if (this_time>next_weather_update)
  {
    Serial.println("Update Weather!");
    ret_code=update_weather();
    if (ret_code)
      next_weather_update=this_time+600000;
    else
      next_weather_update=this_time+5000;
  }

  display.clearDisplay();
  draw_time ();

  // Exchange sun for moon icon when past sunset
  if ((sunset<myTZ.now()) && (icon_show_low[0]<2))
  icon_show_low[0]=icon_show_low[0]+9;
  if ((sunset<myTZ.now()) && (icon_show_high[0]<2))
  icon_show_high[0]=icon_show_high[0]+9;

  // Flip between icons every 2 seconds to animate them a bit
  // Flip between high and lows every 5 seconds
  if (myTZ.second()%20<10)
  {
    // Dot to indicate high or low
    display.drawPixel(0,15,myWHITE);
    draw_weather_icon(icon_show_low[0],0,temperature_show_low[0],(myTZ.second()%4>=2));
    draw_weather_icon(icon_show_low[0],0,temperature_show_low[0],(myTZ.second()%4<2));
    draw_weather_icon(icon_show_low[1],1,temperature_show_low[1],(myTZ.second()%4>=2));
    draw_weather_icon(icon_show_low[1],1,temperature_show_low[1],(myTZ.second()%4<2));
  }
  else
  {
    draw_weather_icon(icon_show_high[0],0,temperature_show_high[0],(myTZ.second()%4>=2));
    draw_weather_icon(icon_show_high[0],0,temperature_show_high[0],(myTZ.second()%4<2));
    draw_weather_icon(icon_show_high[1],1,temperature_show_high[1],(myTZ.second()%4>=2));
    draw_weather_icon(icon_show_high[1],1,temperature_show_high[1],(myTZ.second()%4<2));
    // Dot to indicate high or low
    display.drawPixel(0,11,myWHITE);
  }

  // If we had problems fetching the weather we display a red dot
  if (weather_get_error)
  display.drawPixel(0,0,myRED);
  display.showBuffer();

  delay(100);
}
